## samples/dfu/fw_loader/ble_mcumgr/boards/nrf7120dk_nrf7120_cpuapp.conf
```kconfig
#
# UART transport profile for nRF7120 FPGA validation.
#
CONFIG_BT=n
CONFIG_MCUMGR_TRANSPORT_BT=n
CONFIG_MCUMGR_TRANSPORT_UART=y
CONFIG_BASE64=y
CONFIG_SERIAL=y
CONFIG_UART_CONSOLE=y
CONFIG_PRINTK=y
```

## samples/zephyr/subsys/ipc/ipc_service/icmsg/remote/boards/nrf7120dk_nrf7120_cpuflpr.conf
```kconfig
CONFIG_LOG=y
# Temporarily enable full logging for debugging
# CONFIG_LOG_MODE_MINIMAL=y
CONFIG_ASSERT=n
# CONFIG_LOG_BACKEND_UART=n

# CONFIG_BOOT_BANNER=n
CONFIG_EARLY_CONSOLE=y
CONFIG_HEAP_MEM_POOL_SIZE=1024

CONFIG_SIZE_OPTIMIZATIONS=y

# Debug: enable IPC and MBOX debug logging
CONFIG_IPC_SERVICE_LOG_LEVEL_DBG=y
CONFIG_MBOX_LOG_LEVEL_DBG=y
```

## tests/lib/ram_pwrdn/testcase.yaml
```yaml
tests:
  ram_pwrdn.functionality_test:
    sysbuild: true
    platform_allow:
      - nrf52840dk/nrf52840
      - nrf7120dk/nrf7120/cpuapp
    integration_platforms:
      - nrf52840dk/nrf52840
      - nrf7120dk/nrf7120/cpuapp
    tags:
      - ram_pwrdn
      - sysbuild
      - ci_tests_lib_ram_pwrdn
```
