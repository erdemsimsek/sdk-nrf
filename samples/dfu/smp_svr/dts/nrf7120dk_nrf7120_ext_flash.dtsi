/*
 * Copyright (c) 2026 Nordic Semiconductor ASA
 *
 * SPDX-License-Identifier: LicenseRef-Nordic-5-Clause
 */

#include "nrf7120dk_nrf7120_memory_map_ext_flash.dtsi"

/* SPI00 shares its pins with MSPI00, which drives the external flash. */
&spi00 {
	status = "disabled";
};

&mspi00 {
	status = "okay";
};

&mx25u25645g {
	status = "okay";
};
